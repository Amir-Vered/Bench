## software/firmware/bench-fw/main/Kconfig.projbuild
```kconfig
menu "Bench Configuration"

    config BENCH_WIFI_SSID
        string "Wi-Fi SSID"
        default "YOUR_WIFI_NAME"
        help
            Wi-Fi network name used by Bench firmware.

    config BENCH_WIFI_PASSWORD
        string "Wi-Fi password"
        default "YOUR_WIFI_PASSWORD"
        help
            Wi-Fi password used by Bench firmware.

endmenu
```

## software/firmware/bench-fw/sdkconfig.defaults
```kconfig
CONFIG_IDF_TARGET="esp32s3"
CONFIG_BENCH_WIFI_SSID="YOUR_WIFI_NAME"
CONFIG_BENCH_WIFI_PASSWORD="YOUR_WIFI_PASSWORD"
```
